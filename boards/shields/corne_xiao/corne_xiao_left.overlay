#include "corne_xiao.dtsi"

/* Left: columns D5..D0 (matrix col0 = pinky when D0 is toward the split). */
&kscan0 {
	col-gpios
		= <&xiao_d 5 GPIO_ACTIVE_HIGH>
		, <&xiao_d 4 GPIO_ACTIVE_HIGH>
		, <&xiao_d 3 GPIO_ACTIVE_HIGH>
		, <&xiao_d 2 GPIO_ACTIVE_HIGH>
		, <&xiao_d 1 GPIO_ACTIVE_HIGH>
		, <&xiao_d 0 GPIO_ACTIVE_HIGH>
		;
};
