## boards/shields/Kconfig
```kconfig
# SPDX-License-Identifier: MIT

source "corne_xiao/Kconfig.shield"
source "corne_xiao/Kconfig.defconfig"
```

## boards/shields/corne_xiao/Kconfig.defconfig
```kconfig
# Copyright (c) 2026
# SPDX-License-Identifier: MIT

if SHIELD_CORNE_XIAO_LEFT

config ZMK_KEYBOARD_NAME
	default "Corne XIAO"

config ZMK_SPLIT_ROLE_CENTRAL
	default y

endif

if SHIELD_CORNE_XIAO_LEFT || SHIELD_CORNE_XIAO_RIGHT

config ZMK_SPLIT
	default y

endif
```

## boards/shields/corne_xiao/Kconfig.shield
```kconfig
# Copyright (c) 2026
# SPDX-License-Identifier: MIT

config SHIELD_CORNE_XIAO_LEFT
	def_bool $(shields_list_contains,corne_xiao_left)

config SHIELD_CORNE_XIAO_RIGHT
	def_bool $(shields_list_contains,corne_xiao_right)
```
